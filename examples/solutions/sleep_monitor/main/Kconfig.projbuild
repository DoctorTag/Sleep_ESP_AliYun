## examples/solutions/sleep_monitor/main/Kconfig.projbuild
```kconfig
menu "Test Health Configuration"

config WIFI_SSID
    string "WiFi SSID"
	default "WIFI_HDF"
	help
		SSID (network name) for the example to connect to.

config WIFI_PASSWORD
    string "WiFi Password"
	default "HDF88888"
	help
		WiFi password (WPA or WPA2) for the example to use.
		Can be left blank if the network has no security set.

choice HEALTH_IP_MODE
    prompt "IP Version"
    help
       Example can use either IPV4 or IPV6.

config HEALTH_IPV4
    bool "IPV4"

config HEALTH_IPV6
   bool "IPV6"

endchoice

config HEALTH_PORT
    int "Port"
    range 0 65535
    default 3338
    help
        Test port the health server will listen on.


choice HEALTH_BOARD_TYPE
    bool "Board type"
    default BOARD_CUSTOMER
    help
       Example can define board type.

config BOARD_CUSTOMER
    bool "HealthCare Hardware Board from customer"

config BOARD_PIEZO_ESP32_INTERNAL
    bool "HealthCare Piezo Board with esp32 for internal test"

config BOARD_PIEZO_ESP32_F58GM
    bool "HealthCare Piezo Board with esp32 for F58GM"


config BOARD_DEMO_WB_F58_V00A
   bool "Wristband  Demo Board V00A with F58"

config BOARD_DEMO_PICO_F58
   bool "F58  Demo Board with ESP32 PICO KIT"

config BOARD_DEMO_PICO_Y58
   bool "Y58  Demo Board with ESP32-PICO-D4"

endchoice

endmenu
```
